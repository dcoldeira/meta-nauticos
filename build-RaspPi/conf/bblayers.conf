## build-RaspPi/conf/bblayers.conf
```bitbake
# POKY_BBLAYERS_CONF_VERSION is increased each time build/conf/bblayers.conf
# changes incompatibly
POKY_BBLAYERS_CONF_VERSION = "2"

BBPATH = "${TOPDIR}"
BBFILES ?= ""

BBLAYERS ?= " \
  /home/dcoldeira/cpp/yocto/NauticOS/poky/meta \
  /home/dcoldeira/cpp/yocto/NauticOS/poky/meta-poky \
  /home/dcoldeira/cpp/yocto/NauticOS/poky/meta-yocto-bsp \
  /home/dcoldeira/cpp/yocto/NauticOS/meta-raspberrypi \
  "
```

## meta-nauticos/conf/layer.conf
```bitbake
 BBPATH .= ":${LAYERDIR}"

BBFILES += "${LAYERDIR}/recipes*/*/*.bb \
            ${LAYERDIR}/recipes*/*/*.bbappend \
            "
BBFILE_COLLECTIONS += "nauticos"
BBFILE_PATTERN_nauticos := "^${LAYERDIR}/"
BBFILE_PRIORITY_nauticos = "1"

LAYERSERIES_COMPAT_nauticos = "thud zeus dunfell gatesgarth hardknott"
```
